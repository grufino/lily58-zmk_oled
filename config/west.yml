## config/west.yml
```yaml
manifest:
  remotes:
    - name: zmkfirmware
      url-base: https://github.com/zmkfirmware
    - name: PandaKBLab
      url-base: https://github.com/PandaKBLab
    - name: mctechnology17
      url-base: https://github.com/mctechnology17
  projects:
    - name: zmk
      remote: zmkfirmware
      revision: v0.3
      import: app/west.yml
    # Pinned to commit (not branch) because PandaKB force-pushes "renew"
    # commits that can break builds without warning. Bump manually when
    # you want to pick up shield-side changes.
    - name: zmk-for-PandaKB
      remote: PandaKBLab
      revision: a822044
    - name: zmk-nice-oled
      remote: mctechnology17
      revision: main
  self:
    path: config
```
