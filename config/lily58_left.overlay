/*
 * The right knob (right_encoder) and the sensor list are defined in lily58.keymap:
 * ZMK applies this overlay before the shield files, so shield labels aren't
 * available here. Only per-half enable/disable lives in these overlays.
 */

/ {
    encoder_right {
        status = "disabled";
    };
};
