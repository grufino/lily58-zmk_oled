/*
 * The right knob (right_encoder) and the sensor list are defined in lily58.keymap:
 * ZMK applies this overlay before the shield files, so shield labels aren't
 * available here. Only per-half enable/disable lives in these overlays.
 *
 * Upstream leaves encoder_left enabled on both halves (same pins as the right
 * knob), and its dtsi sets no status, so disabling it here sticks.
 */

/ {
    encoder_left {
        status = "disabled";
    };

    encoder_right {
        status = "okay";
    };
};
